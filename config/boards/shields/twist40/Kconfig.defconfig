## config/boards/shields/twist40/Kconfig.defconfig
```kconfig
if SHIELD_TWIST40

config ZMK_KEYBOARD_NAME
	default "twist40"

endif

if ZMK_DISPLAY

config I2C
    default y

config SSD1306
    default y

choice ZMK_DISPLAY_WORK_QUEUE
    default ZMK_DISPLAY_WORK_QUEUE_DEDICATED
endchoice

endif

if LVGL

config LV_Z_VDB_SIZE
    default 40

config LV_DPI_DEF
    default 92

config LV_Z_BITS_PER_PIXEL
    default 1

choice LV_COLOR_DEPTH
    default LV_COLOR_DEPTH_1
endchoice

endif
```

## config/boards/shields/twist40/Kconfig.shield
```kconfig
# Copyright (c) 2020 Pete Johanson
# SPDX-License-Identifier: MIT

config SHIELD_TWIST40
	def_bool $(shields_list_contains,twist40)
```
